## boards/pcbcupid/glyph_mini_2040/Kconfig
```kconfig
# Copyright (c) 2024 PCB Cupid
# SPDX-License-Identifier: Apache-2.0

config HEAP_MEM_POOL_ADD_SIZE_BOARD
	int
	default 4096 if BOARD_GLYPH_MINI_2040
```
